## config/boards/shields/Kconfig.shield
```kconfig
# Copyright (c) 2020 Pete Johanson
# SPDX-License-Identifier: MIT

config SHIELD_FAW36_LEFT
	def_bool $(shields_list_contains,faw36_left)

config SHIELD_FAW36_RIGHT
	def_bool $(shields_list_contains,faw36_right)
```

## config/boards/shields/faw36/Kconfig.defconfig
```kconfig
# Copyright (c) 2020 The ZMK Contributors
# SPDX-License-Identifier: MIT

config ZMK_BLE
	default y

config ZMK_USB
	default y

if SHIELD_FAW36_LEFT

config ZMK_KEYBOARD_NAME
	default "faw36"

config ZMK_SPLIT_ROLE_CENTRAL
	default y

endif

if SHIELD_FAW36_LEFT || SHIELD_FAW36_RIGHT

config ZMK_SPLIT
	default y

endif
```

## config/boards/shields/faw36/Kconfig.shield
```kconfig
# Copyright (c) 2022 The ZMK Contributors
# SPDX-License-Identifier: MIT

config SHIELD_FAW36_LEFT
	def_bool $(shields_list_contains,faw36_left)

config SHIELD_FAW36_RIGHT
	def_bool $(shields_list_contains,faw36_right)
```

## config/west.yml
```yaml
manifest:
  remotes:
    - name: germain-gadel
      url-base: https://github.com/germain-gadel
    - name: zmkfirmware
      url-base: https://github.com/zmkfirmware
  projects:
    - name: zmk
      remote: zmkfirmware
      revision: main
      import: app/west.yml
  self:
    path: config
```
